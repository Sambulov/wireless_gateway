## main/Kconfig.projbuild
```kconfig
menu "Project Configuration"
    config WEB_SERVER_PORT
        int "Web server port"
        range 0 65535
        default 80
        help
            Set server port number used by web serer.
    config WEB_SERVER_MAX_CLIENTS
        int "Web server connections"
        default 10
        help
            Maximum allowed web clients connections.
    config WEB_SOCKET_MAX_PENDING_API
        int "Pending number"
        default 20
        help
            Maximum queue length of incoming API requests.
    config WEB_SOCKET_PING_DELAY
        int "Web-socket ping delay"
        default 1000
        help
            Web socket clients ping delay
    config WIFI_AP_ENABLE
        bool "Enable Wi-Fi AP"
        default y
        help
            Start the device in AP+STA mode. Disable to run in STA-only mode
            (useful when a STA network is configured and AP is not needed).

    config WIFI_AP_DEFAULT_SSID
        string "Default AP name"
        default "TestNet"
        depends on WIFI_AP_ENABLE
        help
            Set default AP ssid.

    config WIFI_AP_DEFAULT_PASS
        string "Default AP password"
        default "12345678"
        depends on WIFI_AP_ENABLE
        help
            Set default AP password.

    config WIFI_STA_DEFAULT_SSID
        string "Default STA SSID"
        default ""
        help
            SSID of the Wi-Fi network the gateway connects to as a station.
            Leave empty to disable STA mode by default.

    config WIFI_STA_DEFAULT_PASS
        string "Default STA password"
        default ""
        help
            Password for the default STA network.

    config TEST_STRING
            string "test string config parameter"
            default "test str"
            help
                Type something klever or add some other options & properties
                @"Show me the code!!!"

    config QEMU_BUILD
        bool "Build for QEMU emulator"
        default n
        help
            Skip WiFi, TFTP, and HTTP/WebSocket server initialization.
            The ESP32 PHY/radio hardware is not emulated by QEMU; enabling
            this option prevents the LoadStorePIFAddrError crash so that
            NVS, UART, and filesystem code can be tested under QEMU.

endmenu
```
